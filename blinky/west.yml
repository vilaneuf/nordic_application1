## blinky/west.yml
```yaml
manifest:
  remotes:
    - name: ncs
      url-base: https://github.com/vilaneuf
  projects:
    - name: sdk-nrf
      remote: ncs
      path: nrf
      revision: v2.0.0-rc2
      import: true
      clone-depth: 1
  self:
    path: blinky
```
